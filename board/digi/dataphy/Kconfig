## board/digi/dataphy/Kconfig
```kconfig
if TARGET_DATAPHY

config MCA
	bool
	default y

config SYS_BOARD
	default "dataphy"

config SYS_VENDOR
	default "digi"

config SYS_SOC
	default "mx6"

config SYS_CONFIG_NAME
	default "dataphy"

endif
```
